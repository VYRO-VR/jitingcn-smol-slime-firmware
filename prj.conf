## CMakeLists.txt
```
#
# Copyright (c) 2023 Nordic Semiconductor
#
# SPDX-License-Identifier: LicenseRef-Nordic-5-Clause
#
cmake_minimum_required(VERSION 3.20.0)

# Configure VERSION from repository branch and tag
find_package(Git)

if(GIT_EXECUTABLE)
  execute_process(
    COMMAND ${GIT_EXECUTABLE} branch --show-current
    WORKING_DIRECTORY ${CMAKE_SOURCE_DIR}
    OUTPUT_VARIABLE GIT_BRANCH
    )
  execute_process(
    COMMAND ${GIT_EXECUTABLE} describe --dirty --tags --long --match [0-9]*.[0-9]*.[0-9]*
    WORKING_DIRECTORY ${CMAKE_SOURCE_DIR}
    OUTPUT_VARIABLE GIT_VERSION
    )
  # Prefer a https URL for display (falls back to ssh/origin.url)
  execute_process(
    COMMAND ${GIT_EXECUTABLE} config --get remote.origin.url
    WORKING_DIRECTORY ${CMAKE_SOURCE_DIR}
    OUTPUT_VARIABLE GIT_REPO_URL_SSH
    )
  execute_process(
    COMMAND ${GIT_EXECUTABLE} config --get remote.origin.https.url
    WORKING_DIRECTORY ${CMAKE_SOURCE_DIR}
    OUTPUT_VARIABLE GIT_REPO_URL_HTTPS
    )
  execute_process(
    COMMAND ${GIT_EXECUTABLE} log -1 --pretty=%an
    WORKING_DIRECTORY ${CMAKE_SOURCE_DIR}
    OUTPUT_VARIABLE GIT_AUTHOR
    )
endif()

if(GIT_BRANCH STREQUAL "")
  set(GIT_BRANCH unknown)
  message(WARNING "Unknown Git Branch")
endif()

if(GIT_VERSION STREQUAL "")
  set(GIT_VERSION 0.0.0-0)
  message(WARNING "Unknown Tag/Version")
endif()

# Choose URL: origin.https.url > origin.url
if(NOT GIT_REPO_URL_HTTPS STREQUAL "")
  set(GIT_REPO_URL ${GIT_REPO_URL_HTTPS})
else()
  set(GIT_REPO_URL ${GIT_REPO_URL_SSH})
endif()

# Normalize GitHub SSH URLs to HTTPS for display in firmware info
if(GIT_REPO_URL MATCHES "^git@github\\.com:(.+)$")
  set(GIT_REPO_URL "https://github.com/${CMAKE_MATCH_1}")
elseif(GIT_REPO_URL MATCHES "^ssh://git@github\\.com/(.+)$")
  set(GIT_REPO_URL "https://github.com/${CMAKE_MATCH_1}")
endif()
string(REGEX REPLACE "\\.git$" "" GIT_REPO_URL "${GIT_REPO_URL}")

if(GIT_REPO_URL STREQUAL "")
  set(GIT_REPO_URL unknown)
  message(WARNING "Unknown Git Repo URL")
endif()

if(GIT_AUTHOR STREQUAL "")
  set(GIT_AUTHOR unknown)
  message(WARNING "Unknown Git Author")
endif()

string(STRIP ${GIT_BRANCH} GIT_BRANCH)
string(STRIP ${GIT_VERSION} GIT_VERSION)
string(STRIP ${GIT_REPO_URL} GIT_REPO_URL)
string(STRIP ${GIT_AUTHOR} GIT_AUTHOR)

string(REPLACE "-" ";" GIT_VERSION ${GIT_VERSION})
list(GET GIT_VERSION 0 GIT_RELEASE)
list(GET GIT_VERSION 1 GIT_TWEAK)
string(REPLACE "v" "" GIT_RELEASE ${GIT_RELEASE})
string(REPLACE "." ";" GIT_RELEASE ${GIT_RELEASE})
list(GET GIT_RELEASE 0 GIT_MAJOR)
list(GET GIT_RELEASE 1 GIT_MINOR)
list(GET GIT_RELEASE 2 GIT_PATCH)

configure_file(${CMAKE_SOURCE_DIR}/VERSION_SRC ${CMAKE_SOURCE_DIR}/VERSION @ONLY)

# Pass metadata to C compilation units
add_compile_definitions(
  FW_GIT_BRANCH="${GIT_BRANCH}"
  FW_GIT_REPO_URL="${GIT_REPO_URL}"
  FW_GIT_AUTHOR="${GIT_AUTHOR}"
)

# Zephyr
find_package(Zephyr REQUIRED HINTS $ENV{ZEPHYR_BASE})
project(NONE)

find_package(Python3 QUIET COMPONENTS Interpreter)

if(NOT Python3_Interpreter_FOUND)
  find_program(PYTHON_EXECUTABLE NAMES python3 python REQUIRED)
  set(Python3_EXECUTABLE ${PYTHON_EXECUTABLE})
endif()

set(SOFTDEVICE_HEX_52840 ${CMAKE_SOURCE_DIR}/softdevice/s140_nrf52_7.3.0_softdevice.hex)
set(UF2_FAMILY_ID_52840 0xADA52840)
set(UF2_FAMILY_ID_52833 0xADA52840) # Adafruit UF2 family is shared across nRF52 SoCs

set(zephyr_app_hex ${CMAKE_BINARY_DIR}/zephyr/zephyr.hex)
set(mergehex_py ${ZEPHYR_BASE}/scripts/build/mergehex.py)
set(uf2conv_py  ${ZEPHYR_BASE}/scripts/build/uf2conv.py)

if(WITH_SOFTDEVICE)
  if(CONFIG_SOC_NRF52840)
    set(sd_softdevice_hex ${SOFTDEVICE_HEX_52840})
    set(sd_uf2_family_id ${UF2_FAMILY_ID_52840})
  else()
    message(FATAL_ERROR "WITH_SOFTDEVICE is currently only supported on nRF52840 targets")
  endif()

  if(DEFINED sd_softdevice_hex)
    if(NOT EXISTS ${sd_softdevice_hex})
      message(FATAL_ERROR "SoftDevice hex not found: ${sd_softdevice_hex}")
    endif()

    set(sd_merged_hex ${CMAKE_BINARY_DIR}/zephyr/zephyr_sd.hex)
    set(sd_merged_uf2 ${CMAKE_BINARY_DIR}/zephyr/zephyr_sd.uf2)

    add_custom_command(
      OUTPUT ${sd_merged_hex} ${sd_merged_uf2}
      COMMAND ${Python3_EXECUTABLE} ${mergehex_py} --overlap=replace -o ${sd_merged_hex} ${sd_softdevice_hex} ${zephyr_app_hex}
      COMMAND ${Python3_EXECUTABLE} ${uf2conv_py} ${sd_merged_hex} -c -f ${sd_uf2_family_id} -o ${sd_merged_uf2}
      DEPENDS ${sd_softdevice_hex} ${zephyr_app_hex}
      VERBATIM
    )

    add_custom_target(sd_merged_uf2 ALL DEPENDS ${sd_merged_hex} ${sd_merged_uf2})
  endif()
endif()

# ============================================================================
# Combined bootloader + firmware hex (zephyr_full.hex)
#
# pm_static reserves the UF2 bootloader region, but nothing is merged into it
# at build time, so the default zephyr.hex / sysbuild merged.hex contain only
# the application. Flashing those to a fresh nRF52 chip via SWD/J-Link leaves
# it without an MBR, without UICR.NRFFW[0], and without the UF2 bootloader,
# so the device never enumerates over USB.
#
# When a UF2 bootloader hex is supplied, this section produces a real combined
# image (zephyr_full.hex) containing everything needed to flash a virgin chip:
#
#     UF2 bootloader (MBR + bootloader code + UICR)
#   + SoftDevice (when WITH_SOFTDEVICE)
#   + application
#
# Resolution order for the bootloader hex:
#   1. -DUF2_BOOTLOADER_HEX=<path> at cmake time
#   2. UF2_BOOTLOADER_HEX environment variable
#   3. bootloader/<BOARD>.hex   (e.g. bootloader/mochi_uf2.hex)
#   4. bootloader/<SOC>.hex     (e.g. bootloader/nrf52833.hex)
#
# If none of those resolve, zephyr_full.hex is simply not generated and the
# rest of the build proceeds as before.
# ============================================================================

if(NOT DEFINED UF2_BOOTLOADER_HEX AND DEFINED ENV{UF2_BOOTLOADER_HEX})
  set(UF2_BOOTLOADER_HEX $ENV{UF2_BOOTLOADER_HEX})
endif()

if(NOT DEFINED UF2_BOOTLOADER_HEX OR UF2_BOOTLOADER_HEX STREQUAL "")
  set(_uf2_bl_candidates
    ${CMAKE_SOURCE_DIR}/bootloader/${BOARD}.hex
  )
  if(CONFIG_SOC_NRF52840)
    list(APPEND _uf2_bl_candidates ${CMAKE_SOURCE_DIR}/bootloader/nrf52840.hex)
  elseif(CONFIG_SOC_NRF52833)
    list(APPEND _uf2_bl_candidates ${CMAKE_SOURCE_DIR}/bootloader/nrf52833.hex)
  endif()
  foreach(_c ${_uf2_bl_candidates})
    if(EXISTS ${_c})
      set(UF2_BOOTLOADER_HEX ${_c})
      break()
    endif()
  endforeach()
endif()

if(DEFINED UF2_BOOTLOADER_HEX AND NOT UF2_BOOTLOADER_HEX STREQUAL "")
  if(NOT EXISTS ${UF2_BOOTLOADER_HEX})
    message(FATAL_ERROR "UF2_BOOTLOADER_HEX not found: ${UF2_BOOTLOADER_HEX}")
  endif()

  set(full_hex ${CMAKE_BINARY_DIR}/zephyr/zephyr_full.hex)

  # Order matters with --overlap=replace: later inputs win on overlap.
  # Bootloader provides MBR + UICR; SoftDevice (if present) replaces MBR
  # with the Nordic-supplied one; application fills the app region.
  set(full_inputs ${UF2_BOOTLOADER_HEX})
  if(WITH_SOFTDEVICE AND DEFINED sd_softdevice_hex)
    list(APPEND full_inputs ${sd_softdevice_hex})
  endif()
  list(APPEND full_inputs ${zephyr_app_hex})

  add_custom_command(
    OUTPUT ${full_hex}
    COMMAND ${Python3_EXECUTABLE} ${mergehex_py} --overlap=replace -o ${full_hex} ${full_inputs}
    DEPENDS ${full_inputs}
    VERBATIM
  )
  add_custom_target(zephyr_full ALL DEPENDS ${full_hex})

  message(STATUS "Combined hex: ${full_hex}")
  message(STATUS "  bootloader: ${UF2_BOOTLOADER_HEX}")
  if(WITH_SOFTDEVICE AND DEFINED sd_softdevice_hex)
    message(STATUS "  softdevice: ${sd_softdevice_hex}")
  endif()
endif()

# NORDIC SDK APP START
FILE(GLOB_RECURSE app_sources src/*.c)
target_sources(app PRIVATE ${app_sources})

# NORDIC SDK APP END

FILE(GLOB_RECURSE files Fusion/Fusion/*.c)
target_sources(app PRIVATE ${files})

FILE(GLOB_RECURSE files vqf-c/src/*.c)
target_sources(app PRIVATE ${files})

target_include_directories(app PRIVATE src)
target_include_directories(app PRIVATE Fusion/Fusion)
target_include_directories(app PRIVATE vqf-c/src)

# Force recompile for updated build timestamp
add_custom_target(touch_util_h ALL
    COMMAND ${CMAKE_COMMAND} -E touch ${CMAKE_SOURCE_DIR}/src/build_defines.h
)
```

## prj.conf
```kconfig
#CONFIG_NCS_SAMPLES_DEFAULTS
CONFIG_ASSERT=y
CONFIG_ASSERT_NO_COND_INFO=y
CONFIG_ASSERT_NO_MSG_INFO=y
CONFIG_RESET_ON_FATAL_ERROR=n

CONFIG_NCS_APPLICATION_BOOT_BANNER_STRING="SlimeVR-Tracker-nRF"
#CONFIG_NCS_BOOT_BANNER=n
CONFIG_BOOT_BANNER=n

# HEX carries mapped-partition addresses for native UF2 generation.
CONFIG_BUILD_OUTPUT_HEX=y

CONFIG_LTO=y
CONFIG_ISR_TABLES_LOCAL_DECLARATION=y

CONFIG_ESB=y

CONFIG_ENTROPY_GENERATOR=y
CONFIG_HARDWARE_DEVICE_CS_GENERATOR=y
#need to enable for nRF54L
#CONFIG_NRFX_DPPI10=y

CONFIG_ADC=y
CONFIG_ADC_NRFX_SAADC=y
# battery.c owns ADC/GPIO setup; voltage-divider DT nodes supply board metadata.
CONFIG_VOLTAGE_DIVIDER=n
CONFIG_FPU=y

# CMSIS-DSP Configuration for VQF optimization
CONFIG_CMSIS_DSP=y
CONFIG_CMSIS_DSP_FASTMATH=y
CONFIG_CMSIS_DSP_BASICMATH=y
CONFIG_CMSIS_DSP_MATRIX=y
CONFIG_CMSIS_DSP_QUATERNIONMATH=y
CONFIG_CMSIS_DSP_SUPPORT=y
CONFIG_CMSIS_DSP_CONTROLLER=y
CONFIG_DSP=y

CONFIG_I2C=y
CONFIG_SPI=y
CONFIG_PINCTRL=y

CONFIG_NVS=y
CONFIG_NVS_LOOKUP_CACHE=y
CONFIG_NVS_INIT_BAD_MEMORY_REGION=y

CONFIG_POWEROFF=y
CONFIG_REBOOT=y

CONFIG_FLASH=y
CONFIG_FLASH_PAGE_LAYOUT=y
CONFIG_FLASH_MAP=y
CONFIG_USE_DT_CODE_PARTITION=y

CONFIG_SETTINGS=y
CONFIG_SETTINGS_RUNTIME=y
CONFIG_SETTINGS_NONE=y

CONFIG_MPU_ALLOW_FLASH_WRITE=y

CONFIG_RETAINED_MEM=y

CONFIG_USE_SEGGER_RTT=y
CONFIG_LOG=y
#CONFIG_PRINTK=y
CONFIG_LOG_MODE_DEFERRED=y
CONFIG_LOG_SPEED=y
CONFIG_LOG_BACKEND_RTT=y
CONFIG_CBPRINTF_FP_SUPPORT=y
CONFIG_ADC_LOG_LEVEL_OFF=y
CONFIG_LOG_FUNC_NAME_PREFIX_ERR=y
# Absorb multi-line sensor debug bursts without changing their output cadence.
CONFIG_LOG_BUFFER_SIZE=8192
CONFIG_LOG_BACKEND_UART_AUTOSTART=n
CONFIG_LOG_PROCESS_THREAD_SLEEP_MS=25
CONFIG_LOG_PROCESS_THREAD_STACK_SIZE=1024

CONFIG_PWM=y
CONFIG_GPIO=y

CONFIG_CRC=y

# Sensor lifecycle waits (suspend / scan) use k_event instead of busy spins
CONFIG_EVENTS=y

CONFIG_PICOLIBC=y
# CONFIG_NRFX_TIMER1=y

#speed up boot? (use internal rc oscillator)
CONFIG_CLOCK_CONTROL_NRF_K32SRC_RC=y
CONFIG_CLOCK_CONTROL_NRF_K32SRC_20PPM=y

# dont need it
CONFIG_CRYPTO=n

# set timeout for 25ms, sufficient for ~1000 bytes
CONFIG_I2C_NRFX_TRANSFER_TIMEOUT=25

CONFIG_USB_DEVICE_STACK_NEXT=y
CONFIG_USBD_CDC_ACM_CLASS=y
CONFIG_CDC_ACM_SERIAL_INITIALIZE_AT_BOOT=n
CONFIG_SLIMEVR_USB_DEVICE_VID=0x1209
CONFIG_SLIMEVR_USB_DEVICE_PID=0x7692
CONFIG_UART_INTERRUPT_DRIVEN=y

CONFIG_SERIAL=y
CONFIG_CONSOLE=y
CONFIG_RTT_CONSOLE=y
CONFIG_UART_CONSOLE=y
CONFIG_UART_LINE_CTRL=y

CONFIG_LOG=y

CONFIG_LOG_BACKEND_UART=y

CONFIG_CONSOLE_SUBSYS=y

CONFIG_NVS_LOG_LEVEL_WRN=y

CONFIG_SYSTEM_WORKQUEUE_STACK_SIZE=1024
CONFIG_MAIN_STACK_SIZE=2048

CONFIG_THREAD_NAME=y

CONFIG_HEAP_MEM_POOL_SIZE=4096
CONFIG_ISR_STACK_SIZE=2048

CONFIG_PM_DEVICE=y


CONFIG_USE_ACTIVE_TIMEOUT=y

# 100ms switch delay will be obvious to users, so we choose not to use it by default,
# but it can be enabled for testing or specific use cases
CONFIG_SENSOR_USE_LOW_POWER_2=n

# control low power mode
# due to current mag reading is process in sensor loop,
# low power mode will cause mag reading isn't at target odr,
# so currently it should be disabled by default
CONFIG_USE_IMU_TIMEOUT=n
# a very large low power timeout (1h) to prevent it from triggering
CONFIG_SENSOR_LP_TIMEOUT=3600000

# 10 minutes timeout with wake on motion
CONFIG_ACTIVE_TIMEOUT_DELAY=600000

# dynamic low-activity sleep timeout is 90 seconds, repeat wake timeout is 90 seconds by default
CONFIG_ACTIVE_TIMEOUT_IDLE_WAKE_DELAY=90000
CONFIG_DYNAMIC_ACTIVE_TIMEOUT=y
CONFIG_USE_IMU_WAKE_UP=y

# or 6 hours timeout
# CONFIG_USE_IMU_WAKE_UP=n
# CONFIG_ACTIVE_TIMEOUT_DELAY=21600000

CONFIG_USER_EXTRA_ACTIONS=y
CONFIG_DISABLE_SENSOR_GPIOS_ON_SHUTDOWN=y

CONFIG_ESB_MAX_PAYLOAD_LENGTH=72
CONFIG_ESB_TX_FIFO_SIZE=8
CONFIG_ESB_RX_FIFO_SIZE=8
CONFIG_RADIO_RF_CHANNEL=84
CONFIG_RADIO_RETRANSMIT_DELAY=310
CONFIG_CONNECTION_ENABLE_ACK=n
CONFIG_RADIO_TX_POWER=8
# 30 minutes before shutdown when receiver unreachable (was 3 min — too short for movie breaks)
CONFIG_CONNECTION_TIMEOUT_DELAY=1800000

CONFIG_SENSOR_USE_ACCEL_CALIBRATION=y
CONFIG_SENSOR_USE_SENS_CALIBRATION=y
CONFIG_SENSOR_SENS_REV=5

CONFIG_SENSOR_USE_TCAL=y

# Boot calibration: auto-measures gyro bias at startup when stationary
CONFIG_SENSOR_USE_BOOT_CALIBRATION=y

# Range statistics tracking (disabled by default to optimize performance)
# CONFIG_SENSOR_RANGE_STATS=y

# Gyro/accel ODR. Gyro OVERSAMPLING = Δq INT_merge factor.
# Example: GYRO_ODR=1600 + GYRO_OVERSAMPLING=4 → 400 Hz fusion gyro steps.
# icm45 ~1600, dsv ~1920
CONFIG_SENSOR_GYRO_ODR=400
# fusion rate at ~400Hz
CONFIG_SENSOR_GYRO_OVERSAMPLING=1
CONFIG_SENSOR_MAG_ODR=100

# enable Adaptive VQF tauAcc
CONFIG_VQF_ADAPTIVE_TAU_ACC=y

# Watchdog Configuration
CONFIG_WATCHDOG=y
CONFIG_WDT_NRFX=y
CONFIG_TASK_WDT=y
CONFIG_TASK_WDT_CHANNELS=9
CONFIG_TASK_WDT_HW_FALLBACK=y
CONFIG_TASK_WDT_HW_FALLBACK_DELAY=5000

# enable tdma on board which don't have lfxo, it can use lf clock synthesized by hf clock,
# but it will increase a lot of power consumption, so if you want to use it, you can enable below config,
# or define it in board level Kconfig file.

# CONFIG_CLOCK_USE_LFXO=n
CONFIG_CONNECTION_TDMA=y

# LSM6DSV SPI recovery — required for Mochi to recover from corrupted IMU SPI
# state on battery power-on. Do not enable on boards using a different SPI IMU.
CONFIG_IMU_SPI_LSM6DSV_RECOVERY=y

# Last-resort drain-and-recover when the IMU is hardware-latched and no
# bus-level recovery works. Drains the battery in ~1-2 hours so the IMU
# eventually sees a real POR. Customer flow: tracker shows the red sensor-missing LED
# pattern, customer waits for it to power off,
# then plugs in USB-C to recover.
CONFIG_IMU_LOCKUP_DRAIN_RECOVERY=y

# Enable VQF benchmark mode for performance testing (disabled by default)
# CONFIG_VQF_BENCH=y

CONFIG_TRACKER_EVENT_FUSION_REST=n
```

## src/console.h
```c
#ifndef SLIMENRF_CONSOLE
#define SLIMENRF_CONSOLE

#include <stdint.h>

void console_thread_create(void);
void console_thread_abort(void);

// Command API for remote execution
void cmd_sens_set(float x, float y, float z);
void cmd_sens_auto(const char *axis_str, const char *rev_str);
void cmd_sens_auto_request(uint8_t axis, uint16_t revolutions);
void cmd_sens_reset(void);
void cmd_sens_status(void);
void cmd_reset_zro(void);
void cmd_reset_acc(void);
void cmd_reset_bat(void);
void cmd_reset_tcal(void);
void cmd_fusion_reset(void);
void cmd_ping_start(void);
void cmd_shutdown(void);

#endif
```
